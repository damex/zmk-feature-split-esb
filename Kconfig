## Kconfig
```kconfig
# Copyright 2026 Roman Kuzmitskii (@damex)
# SPDX-License-Identifier: MIT

menuconfig ZMK_SPLIT_ESB
    bool "ZMK ESB split transport"
    depends on ZMK_SPLIT
    select ESB
    help
      Enhanced ShockBurst (2.4 GHz) split transport for one or more peripherals and a
      single central. One ESB packet carries one complete split message.
      ESB hardware ACK, retransmit and CRC provide reliability.

if ZMK_SPLIT_ESB

config ZMK_SPLIT_ESB_MAX_PAYLOAD
    int "Max on-air payload bytes"
    default 48
    help
      Must be >= the largest split message struct. A build assert checks this.

config ZMK_SPLIT_ESB_RX_QUEUE_SIZE
    int "Received-packet ring depth (power of 2)"
    default 16
    help
      Lock-free SPSC ring between the radio ISR and the dispatch thread. Must be
      a power of 2. Deep enough to ride out dispatch stalls at the RX rate.

config ZMK_SPLIT_ESB_EVENT_QUEUE_SIZE
    int "Central: behavior-bound event queue depth"
    default 16
    help
      Key, sensor and battery events queue here for the system workqueue,
      where ZMK behavior state lives. Input events bypass this queue.

config ZMK_SPLIT_ESB_COMMAND_QUEUE_SIZE
    int "Peripheral: inbound command queue depth"
    default 8
    help
      Central commands (behavior invocations, HID indicators) queue here for
      the system workqueue.

config ZMK_SPLIT_ESB_PRIORITY
    int "Split transport registration priority"
    default 50

config ZMK_SPLIT_ESB_BATTERY_LOG
    bool "Log peripheral battery changes on the central"
    help
      Battery level changes to the central log, one line per percent step.
      Diagnostic only, needs a log backend.

menuconfig ZMK_SPLIT_ESB_WIRE
    bool "Wire link between split peripherals"
    select SERIAL
    select UART_INTERRUPT_DRIVEN
    select RING_BUFFER
    select CRC
    help
      Bidirectional UART link between two split peripherals. Reuses the ESB
      wire packet format above raw framing. Base transport for wire-central
      and wire-peripheral sub-roles.

choice ZMK_SPLIT_ESB_PERIPHERAL_TRANSPORT
    prompt "Peripheral transport"
    depends on !ZMK_SPLIT_ROLE_CENTRAL
    default ZMK_SPLIT_ESB_PERIPHERAL_TRANSPORT_ESB

config ZMK_SPLIT_ESB_PERIPHERAL_TRANSPORT_ESB
    bool "ESB radio"

config ZMK_SPLIT_ESB_PERIPHERAL_TRANSPORT_WIRE
    bool "Wire (UART / USB CDC)"
    select ZMK_SPLIT_ESB_WIRE

endchoice

config ZMK_SPLIT_ESB_WIRE_RELAY
    bool "Relay events from a wire peer"
    depends on ZMK_SPLIT_ESB_PERIPHERAL_TRANSPORT_ESB
    select ZMK_SPLIT_ESB_WIRE
    help
      Peripheral acts as wire central for another split peripheral over the
      wire link. Received events land at wire_relay for future forwarding
      through the ESB uplink.

if ZMK_SPLIT_ESB_WIRE

config ZMK_SPLIT_ESB_WIRE_KEEPALIVE_MS
    int "Wire link keepalive period, ms"
    default 100

config ZMK_SPLIT_ESB_WIRE_STATE_MS
    int "Wire peripheral state broadcast period, ms"
    default 500

config ZMK_SPLIT_ESB_WIRE_TIMEOUT_MS
    int "Wire link peer-alive timeout, ms"
    default 500

endif # ZMK_SPLIT_ESB_WIRE

module = ZMK_SPLIT_ESB
module-str = ZMK ESB split transport
source "subsys/logging/Kconfig.template.log_config"

endif # ZMK_SPLIT_ESB
```

## dts/bindings/zmk,input-processor-esb-relay-pointer.yaml
```yaml
---
# Copyright 2026 Roman Kuzmitskii (@damex)
# SPDX-License-Identifier: MIT

description: Input processor relaying pointer reports to HID relay dongles.

compatible: zmk,input-processor-esb-relay-pointer

include: ip_zero_param.yaml
```

## tests/mock/hid_state_sync/module/Kconfig
```kconfig
# Copyright 2026 Roman Kuzmitskii (@damex)
# SPDX-License-Identifier: MIT

config ZMK_SPLIT_ESB_MAX_PAYLOAD
    int
    default 48

config ESB_MAX_PAYLOAD_LENGTH
    int
    default 48

module = ZMK_SPLIT_ESB
module-str = ZMK ESB split transport
source "subsys/logging/Kconfig.template.log_config"
```

## tests/mock/module/Kconfig
```kconfig
# Copyright 2026 Roman Kuzmitskii (@damex)
# SPDX-License-Identifier: MIT

config ZMK_SPLIT_ESB_MAX_PAYLOAD
    int
    default 48

config ESB_MAX_PAYLOAD_LENGTH
    int
    default 48

config ZMK_SPLIT_ESB_HID_RELAY_KEEPALIVE_MS
    int
    default 4

config ZMK_SPLIT_ESB_HID_RELAY_POLL_MS
    int
    default 4

config ZMK_SPLIT_ESB_TEST_KEYBOARD_TAPS
    int "Keyboard taps the relay must deliver"
    default 1

config ZMK_SPLIT_ESB_TEST_CONSUMER_TAPS
    int "Consumer taps the relay must deliver"
    default 1

module = ZMK_SPLIT_ESB
module-str = ZMK ESB split transport
source "subsys/logging/Kconfig.template.log_config"
```

## tests/native_sim/wire_link/testcase.yaml
```yaml
---
common:
  tags:
    - esb

tests:
  esb.wire_link:
    platform_allow:
      - native_sim/native/64
    integration_platforms:
      - native_sim/native/64
```

## tests/unit/testcase.yaml
```yaml
---
# Copyright 2026 Roman Kuzmitskii (@damex)
# SPDX-License-Identifier: MIT

common:
  tags:
    - esb

tests:
  esb.unit:
    type: unit
```

## west.yml
```yaml
---
# Copyright 2026 Roman Kuzmitskii (@damex)
# SPDX-License-Identifier: MIT

manifest:
  remotes:
    - name: nrfconnect
      url-base: https://github.com/nrfconnect

  projects:
    - name: sdk-nrf
      remote: nrfconnect
      revision: v3.1.1
      path: nrf

    - name: nrfxlib
      remote: nrfconnect
      repo-path: sdk-nrfxlib
      revision: v3.1.1
      path: nrfxlib
```
