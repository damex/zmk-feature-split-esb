## dts/bindings/zmk,split-esb.yaml
```yaml
# Copyright 2026 Roman Kuzmitskii (@damex)
# SPDX-License-Identifier: MIT

description: |
  Shared ESB link identity for a ZMK ESB split.
  The central and every peripheral must declare identical values to pair.
  Place this node in a dtsi included by the central and every peripheral.

compatible: "zmk,split-esb"

properties:
  base-address:
    type: uint8-array
    required: true
    description: |
      4-byte ESB base address, shared across pipes. Vary bytes.
      All-same-byte on-air address (base plus matching prefix) syncs poorly.
  address-length:
    type: int
    default: 5
    enum: [3, 4, 5]
    description: |
      On-air address bytes (1 prefix plus base). 5 is standard ESB. Shorter trims a
      byte per packet but weakens address selectivity. Uses the high base-address
      bytes. All peripherals must match the central.
  hop-channels:
    type: uint8-array
    description: |
      Candidate RF channel pool, each 0-100 (2400 + N MHz).
      Optional. Default sits above 802.11 channel 11 (ESB 74-83, 2474-2483 MHz), the only
      stretch WiFi 1/6/11 leaves clear even against 40 MHz channels, so the link stays off
      WiFi out of the box. The engine measures the pool from live traffic and masks any
      channel that still performs badly. Set explicitly to use a different band. One channel
      means fixed operation.
    default: [74, 75, 76, 77, 78, 79, 80, 81, 82, 83]
  hop-anchors:
    type: uint8-array
    description: |
      Rendezvous channels, a subset of hop-channels, kept unmaskable so a lost link always
      re-finds the central on known spectrum. Pick channels clear of local WiFi, since the
      engine can never mask these.
      Every entry must appear in hop-channels.
      Build assert rejects one that does not.
      Omit and the engine spreads min(3, hop-channels length) anchors evenly over the pool,
      so a custom pool needs no anchor list of its own.
  hop-threshold:
    type: int
    default: 24
    description: |
      Graded loss before acting. A fully-lost window scores 4, so the default tolerates
      five bad windows and hops on the sixth, riding out brief interference instead of
      fleeing it. Central: weighted link-loss sum across peripherals that triggers a
      coordinated hop. Peripheral: sweep trigger for the failed-window streak.
  hop-min-active:
    type: int
    default: 6
    description: |
      Floor on channels the central keeps active. Masking never drops below this, so a
      single interferer can never strand the link without frequency diversity to escape to.
  hop-mask-threshold:
    type: int
    default: 16
    description: |
      Accumulated per-channel bad score at which the central masks a channel out of the hop
      set. Each bad window on the channel adds its graded penalty; each clean window decays it.
      Higher is more patient. Echoes hop-threshold's accumulate-to-a-number shape.
  hop-restore-windows:
    type: int
    default: 64
    description: |
      Base decision windows a masked channel waits before the central re-admits it to retest.
      A masked channel is not measured, so this paces blind retries. A channel that keeps failing
      retest backs off exponentially from this base, so persistent interferers stop pulling the
      live link onto known-bad spectrum every period. Higher thrashes less.
  hop-window-ms:
    type: int
    default: 32
    description: Peripheral keepalive period while data is flowing.
  rssi-floor-dbm:
    type: int
    default: -85
    description: |
      Central hop trigger. A served peripheral whose motion arrives weaker than this (dBm)
      counts the window as degraded, so the link hops toward a better-propagating channel.
      Set near where the link actually fails, or it hops chasing a merely-distant peer.
  idle-keepalive-ms:
    type: int
    default: 128
    description: |
      Peripheral keepalive period when no data is flowing. Also the central's hop-decision
      window period.
  peripheral-timeout-ms:
    type: int
    default: 3000
    description: |
      Central declares a peripheral silent for this long stale and releases its held
      state (keys, input-split buttons), the connectionless equivalent of a disconnect.
      A keepalive from the returning peripheral re-syncs anything still held.
  tx-power-dbm:
    type: int
    default: 0
    description: Boot TX output power, dBm. Radio rounds to nearest supported level.
  retransmit-count:
    type: int
    default: 3
    description: Hardware retransmit attempts before an unacked packet is dropped.
  retransmit-delay-us:
    type: int
    default: 600
    description: Delay between retransmits, microseconds.
  use-fast-ramp-up:
    type: boolean
    description: |
      Shorter radio TX/RX ramp-up delay.
      nRF52/nRF53 only.
      All peripherals must match the central.
  crc-bits:
    type: int
    default: 16
    enum: [0, 8, 16]
    description: CRC width in bits (0 disables CRC). All peripherals must match the central.
  bitrate-kbps:
    type: int
    default: 2000
    enum: [1000, 2000]
    description: Radio bitrate in kbps. All peripherals must match the central.
  lossy-codes:
    type: array
    description: |
      Input axes the peripheral sends without ACK.
      Each entry is two cells, an INPUT_EV_* type and its INPUT_*_<NAME> code,
      e.g. <INPUT_EV_REL INPUT_REL_X>, <INPUT_EV_REL INPUT_REL_Y>.
      Reserve for high-rate, self-correcting axes (pointer motion).
      Non-input split events (key-position, sensor, battery) are always ACK'd, and
      every other input event is ACK'd unless listed.
      Omit for fully lossless link.

child-binding:
  description: Peripheral table container.
  child-binding:
    description: One ESB peripheral.
    properties:
      pipe:
        type: int
        required: true
        description: ESB pipe index, also the ZMK source id.
      prefix:
        type: int
        required: true
        description: 1-byte address prefix, distinct per pipe.
      weight:
        type: int
        default: 1
        description: Relative weight in the central's hop vote.
      reply-queue-depth:
        type: int
        default: 8
        description: |
          Central's command backlog for this peripheral. Raise it for one that receives
          many commands. Beacons and mask updates bypass it, each riding a per-pipe latch
          that the newest value overwrites.
```
