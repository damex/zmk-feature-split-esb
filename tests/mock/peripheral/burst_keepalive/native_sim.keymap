#include <dt-bindings/zmk/kscan_mock.h>

&kscan {
    /delete-property/ exit-after;
    events = <
        ZMK_MOCK_PRESS(0,0,150)
        ZMK_MOCK_RELEASE(0,0,16)
        ZMK_MOCK_PRESS(0,1,16)
        ZMK_MOCK_RELEASE(0,1,16)
        ZMK_MOCK_PRESS(0,1,16)
        ZMK_MOCK_RELEASE(0,1,16)
        ZMK_MOCK_PRESS(0,1,16)
        ZMK_MOCK_RELEASE(0,1,16)
        ZMK_MOCK_PRESS(0,1,16)
        ZMK_MOCK_RELEASE(0,1,16)
        ZMK_MOCK_PRESS(0,1,16)
        ZMK_MOCK_RELEASE(0,1,16)
        ZMK_MOCK_PRESS(0,1,16)
        ZMK_MOCK_RELEASE(0,1,16)
        ZMK_MOCK_PRESS(0,1,16)
        ZMK_MOCK_RELEASE(0,1,16)
        ZMK_MOCK_PRESS(0,1,16)
        ZMK_MOCK_RELEASE(0,1,16)
        ZMK_MOCK_PRESS(0,1,16)
        ZMK_MOCK_RELEASE(0,1,16)
        ZMK_MOCK_PRESS(0,1,16)
        ZMK_MOCK_RELEASE(0,1,16)
    >;
};
